## config/boards/shields/paws/Kconfig.defconfig
```kconfig
if SHIELD_PAWS_LEFT

config ZMK_KEYBOARD_NAME
    default "Split Paws Keeb"

config ZMK_SPLIT_ROLE_CENTRAL
    default y

endif

if SHIELD_PAWS_LEFT || SHIELD_PAWS_RIGHT

config ZMK_SPLIT
    default y

endif
```

## config/boards/shields/paws/Kconfig.shield
```kconfig
config SHIELD_PAWS_LEFT
    def_bool $(shields_list_contains,paws_left)
config SHIELD_PAWS_RIGHT
    def_bool $(shields_list_contains,paws_right)
```
